## Collettore_Planare_Direct_2_0/main/Kconfig.projbuild
```kconfig
menu "Device Configuration"

config WEB_SERVER
        string "Web Server"
        default "cloud.bestechnology.it"

config WEB_URL
        string "Web Url"
        default "https://cloud.bestechnology.it/api/device/connected"

config WEB_PORT
        string "Web Server Port"
        default "80"

config ESP_WIFI_SSID
        string "WiFi SSID"
        default "MKT-CONFIG"
        help
            SSID (network name) to connect to.

config ESP_WIFI_PASSWORD
        string "WiFi Password"
        default "mktcfg00"
        help
            WiFi password (WPA or WPA2) to use.

config ESP_MAXIMUM_RETRY
        int "Maximum retry"
        default 10
        help
            Set the Maximum retry to avoid station reconnecting to the AP unlimited when the AP is really inexistent.

config MQTT_URL
    string "MQTT broker URL"
    default "mqtt://192.168.5.1:1883"
    help
        URL of the broker to connect to

config DEVICE_VERSION
    string "Device version"
    default "0.0.1"
    help
        Config device version

config FIRMWARE_UPGRADE_URL
    string "Firmware upgrade url endpoint"
    default "https://192.168.5.1:8443/"
    help
        URL of server which hosts the firmware image.

endmenu
```
